## anemometer-production/sdkconfig.defaults
```kconfig
#
# Sleep Config
#
CONFIG_ESP_SLEEP_RTC_BUS_ISO_WORKAROUND=y
CONFIG_ESP_SLEEP_GPIO_RESET_WORKAROUND=y
CONFIG_ESP_SLEEP_PSRAM_LEAKAGE_WORKAROUND=y
CONFIG_ESP_SLEEP_FLASH_LEAKAGE_WORKAROUND=y
CONFIG_ESP_SLEEP_MSPI_NEED_ALL_IO_PU=y
CONFIG_ESP_SLEEP_DEEP_SLEEP_WAKEUP_DELAY=2000
# end of Sleep Config

CONFIG_FREERTOS_USE_TICKLESS_IDLE=y
CONFIG_FREERTOS_IDLE_TIME_BEFORE_SLEEP=3

#
# Power Management
#
CONFIG_PM_ENABLE=y
CONFIG_PM_DFS_INIT_AUTO=y

# Disable Bluetooth
CONFIG_BT_ENABLED=n

CONFIG_ESP_MAIN_TASK_AFFINITY=ESP_MAIN_TASK_AFFINITY_CPU1
CONFIG_ESP_DEFAULT_CPU_FREQ_MHZ=ESP_DEFAULT_CPU_FREQ_MHZ_240


# The low-latency executor runs off from the main thread
CONFIG_ESP_MAIN_TASK_STACK_SIZE=50000

# Necessary, as we process Rust code on the system event loop, and sometimes run out of stack
CONFIG_ESP_SYSTEM_EVENT_TASK_STACK_SIZE=4096

# This is 10 by default. 16 is the maximum
CONFIG_LWIP_MAX_SOCKETS=16

# Enable the option to dispatch timer events directly from the timer ISR 
# (the executor & async timer wrapper of `esp-idf-svc` are compatible with this dispatch method)
# This has lower latency as compared to dispatching via an intermediate task
# SAFETY: currently there is a bug in esp-idf which results in a crash in
# long running tasks - so this needs to be disabled
CONFIG_ESP_TIMER_SUPPORTS_ISR_DISPATCH_METHOD=n

# Enable posting to event loops directly from an ISR 
# (the event loop wrapper of `esp-idf-svc` is compatible with this, including the async postbox wrapper)
CONFIG_ESP_EVENT_POST_FROM_ISR=y

# Use this to set FreeRTOS kernel tick frequency to 1000 Hz (100 Hz by default).
# This allows to use 1 ms granuality for thread sleeps (10 ms by default).
#CONFIG_FREERTOS_HZ=1000

CONFIG_LOG_DEFAULT_LEVEL=LOG_DEFAULT_LEVEL_NONE
#CONFIG_LOG_DEFAULT_LEVEL=LOG_DEFAULT_LEVEL_DEBUG

CONFIG_MBEDTLS_CERTIFICATE_BUNDLE=y
CONFIG_MBEDTLS_CERTIFICATE_BUNDLE_DEFAULT_FULL=y

# Amazon Root CA Certificate Bundle
#CONFIG_MBEDTLS_CERTIFICATE_BUNDLE=y
#CONFIG_MBEDTLS_CERTIFICATE_BUNDLE_DEFAULT_NONE=y
#CONFIG_MBEDTLS_CUSTOM_CERTIFICATE_BUNDLE=y
#CONFIG_MBEDTLS_CUSTOM_CERTIFICATE_BUNDLE_PATH="../../../../../../../../weatherStationSecrets/anemometer/root-ca"

# Enable app rollback support.
CONFIG_BOOTLOADER_APP_ROLLBACK_ENABLE=y

CONFIG_LOG_TIMESTAMP_SOURCE=LOG_TIMESTAMP_SOURCE_SYSTEM
#CONFIG_LWIP_DEBUG=y
#CONFIG_LWIP_SNTP_DEBUG=y
#CONFIG_LWIP_DNS_DEBUG=y

# CONFIG_MBEDTLS_DYNAMIC_BUFFER is not set
#CONFIG_MBEDTLS_DEBUG=y
# CONFIG_MBEDTLS_DEBUG_LEVEL_WARN is not set
# CONFIG_MBEDTLS_DEBUG_LEVEL_INFO is not set
# CONFIG_MBEDTLS_DEBUG_LEVEL_DEBUG is not set
#CONFIG_MBEDTLS_DEBUG_LEVEL_VERBOSE=y
#CONFIG_MBEDTLS_DEBUG_LEVEL=4

#
# The TiniyS3 has 8MB ESP PSRAM installed we use it for
# additional heap memory
# The system is only stable with PSRAM SPI bus frequency
# set to 40MHz for memeory access.
#
CONFIG_SPIRAM=y
CONFIG_SPIRAM_MODE_QUAD=y
CONFIG_SPIRAM_TYPE_AUTO=n
CONFIG_SPIRAM_TYPE_ESPPSRAM64=y
CONFIG_SPIRAM_ALLOW_STACK_EXTERNAL_MEMORY=y
CONFIG_SPIRAM_CLK_IO=30
CONFIG_SPIRAM_CS_IO=26
CONFIG_SPIRAM_SPEED_40M=y
CONFIG_SPIRAM_SPEED=40
CONFIG_SPIRAM_BOOT_INIT=y
CONFIG_SPIRAM_USE_MALLOC=y
CONFIG_SPIRAM_MEMTEST=y
CONFIG_SPIRAM_MALLOC_ALWAYSINTERNAL=16384
CONFIG_SPIRAM_TRY_ALLOCATE_WIFI_LWIP=y
CONFIG_SPIRAM_MALLOC_RESERVE_INTERNAL=32768

# Use MQTT 5.0
CONFIG_MQTT_PROTOCOL_5=y
```

## sdkconfig.defaults
```kconfig
# Rust often needs a bit of an extra main task stack size compared to C (the default is 3K)
CONFIG_ESP_MAIN_TASK_STACK_SIZE=8196

# OTA Support
CONFIG_ESPTOOLPY_FLASHSIZE_4MB=y
CONFIG_PARTITION_TABLE_TWO_OTA=y
#CONFIG_HTTPD_MAX_REQ_HDR_LEN=1024
#CONFIG_HTTPD_MAX_URI_LEN=1024
# Use this to set FreeRTOS kernel tick frequency to 1000 Hz (100 Hz by default).
# This allows to use 1 ms granuality for thread sleeps (10 ms by default).
#CONFIG_FREERTOS_HZ=1000

# Workaround for https://github.com/espressif/esp-idf/issues/7631
#CONFIG_MBEDTLS_CERTIFICATE_BUNDLE=y
#CONFIG_MBEDTLS_CERTIFICATE_BUNDLE_DEFAULT_FULL=y

# TODO this does not seem to work (should enable log level DEBUG)
#CONFIG_LOG_DEFAULT_LEVEL_INFO=n
#CONFIG_LOG_DEFAULT_LEVEL=4

#
# Log output
#
# CONFIG_LOG_DEFAULT_LEVEL_NONE is not set
# CONFIG_LOG_DEFAULT_LEVEL_ERROR is not set
# CONFIG_LOG_DEFAULT_LEVEL_WARN is not set
# CONFIG_LOG_DEFAULT_LEVEL_INFO is not set
# CONFIG_LOG_DEFAULT_LEVEL_DEBUG is not set
CONFIG_LOG_DEFAULT_LEVEL_VERBOSE=n
CONFIG_LOG_DEFAULT_LEVEL=3
CONFIG_LOG_MAXIMUM_EQUALS_DEFAULT=y
CONFIG_LOG_MAXIMUM_LEVEL=5
CONFIG_LOG_COLORS=y
CONFIG_LOG_TIMESTAMP_SOURCE_RTOS=y
# CONFIG_LOG_TIMESTAMP_SOURCE_SYSTEM is not set
# end of Log output


#
# ESP HTTP client
#
CONFIG_ESP_HTTP_CLIENT_ENABLE_HTTPS=y
# CONFIG_ESP_HTTP_CLIENT_ENABLE_BASIC_AUTH is not set
CONFIG_ESP_HTTP_CLIENT_ENABLE_DIGEST_AUTH=y
# end of ESP HTTP client

#
# HTTP Server
#
CONFIG_HTTPD_MAX_REQ_HDR_LEN=1024
CONFIG_HTTPD_MAX_URI_LEN=1024
CONFIG_HTTPD_ERR_RESP_NO_DELAY=y
CONFIG_HTTPD_PURGE_BUF_LEN=32
# CONFIG_HTTPD_LOG_PURGE_DATA is not set
# CONFIG_HTTPD_WS_SUPPORT is not set
# end of HTTP Server

#
```
